## boards/fruitjam_rp2350/Kconfig
```kconfig
# SPDX-FileCopyrightText: 2026 Core Devices LLC
# SPDX-License-Identifier: Apache-2.0

config BOARD_FRUITJAM_RP2350
    bool
    default y
    select BOARD_FAMILY_FRUITJAM
```

## boards/fruitjam_rp2350/defconfig
```kconfig
# Fruit Jam RP2350 board configuration

CONFIG_SOC_RP2350=y

CONFIG_PLATFORM_FLINT=y

CONFIG_SCREEN_COLOR_DEPTH_BITS_1=y

CONFIG_UART=y
CONFIG_UART_RP2350=y

CONFIG_DISPLAY=y
CONFIG_DISPLAY_SHARP_LS013B7DH01_RP2350=y

CONFIG_FLASH=y
CONFIG_FLASH_RP2350_XIP=y

CONFIG_OTP=y
CONFIG_OTP_FLASH=y

CONFIG_BATTERY=y
CONFIG_BATTERY_STUB=y

CONFIG_WATCHDOG=y
CONFIG_WATCHDOG_STUB=y

CONFIG_EXTI=y
CONFIG_EXTI_RP2350=y

CONFIG_GPIO=y
CONFIG_GPIO_RP2350=y

CONFIG_RTC=y
CONFIG_RTC_RP2350=y

CONFIG_RNG=y
CONFIG_RNG_STUB=y

CONFIG_TEMPERATURE=y
CONFIG_TEMPERATURE_STUB=y

CONFIG_CPUMODE=y
CONFIG_CPUMODE_STUB=y
```

## boards/pico2_w_rp2350/Kconfig
```kconfig
# SPDX-FileCopyrightText: 2026 Core Devices LLC
# SPDX-License-Identifier: Apache-2.0

config BOARD_PICO2_W_RP2350
    bool
    default y
    select BOARD_FAMILY_PICO2_W
```

## boards/pico2_w_rp2350/defconfig
```kconfig
# Raspberry Pi Pico 2 W RP2350 board configuration

CONFIG_SOC_RP2350=y

CONFIG_PLATFORM_FLINT=y

CONFIG_SCREEN_COLOR_DEPTH_BITS_1=y

CONFIG_UART=y
CONFIG_UART_RP2350=y

CONFIG_DISPLAY=y
CONFIG_DISPLAY_SHARP_LS013B7DH01_RP2350=y

CONFIG_FLASH=y
CONFIG_FLASH_RP2350_XIP=y
CONFIG_RP2350_PEBBLE_STORAGE_ONBOARD_XIP=y

CONFIG_OTP=y
CONFIG_OTP_FLASH=y

CONFIG_BATTERY=y
CONFIG_BATTERY_STUB=y

CONFIG_WATCHDOG=y
CONFIG_WATCHDOG_STUB=y

CONFIG_EXTI=y
CONFIG_EXTI_RP2350=y

CONFIG_GPIO=y
CONFIG_GPIO_RP2350=y

CONFIG_RTC=y
CONFIG_RTC_RP2350=y
CONFIG_RP2350_EXTERNAL_RTC_NONE=y

CONFIG_RNG=y
CONFIG_RNG_STUB=y

CONFIG_TEMPERATURE=y
CONFIG_TEMPERATURE_STUB=y

CONFIG_CPUMODE=y
CONFIG_CPUMODE_STUB=y

CONFIG_BT_FW_STUB=y
```

## hardware_tests/fruitjam_esp32c6_hci/sdkconfig.defaults
```kconfig
# Fruit Jam ESP32-C6 BLE controller firmware.
CONFIG_BT_ENABLED=y
CONFIG_BT_CONTROLLER_ONLY=y
CONFIG_BT_LE_HCI_INTERFACE_USE_UART=y
CONFIG_BT_LE_UART_HCI_NO_DMA_MODE=y
CONFIG_BT_LE_HCI_UART_PORT=1
CONFIG_BT_LE_HCI_UART_TX_PIN=16
CONFIG_BT_LE_HCI_UART_RX_PIN=17
CONFIG_BT_LE_HCI_UART_BAUD=115200
# CONFIG_BT_LE_HCI_UART_FLOWCTRL is not set

# UART1 is the HCI data path on Fruit Jam, so keep firmware chatter off it.
CONFIG_ESP_CONSOLE_NONE=y
CONFIG_ESP_CONSOLE_SECONDARY_NONE=y
CONFIG_BOOTLOADER_LOG_LEVEL_NONE=y
CONFIG_LOG_DEFAULT_LEVEL_NONE=y
CONFIG_ESP_SYSTEM_PANIC_SILENT_REBOOT=y

CONFIG_ESPTOOLPY_FLASHSIZE_4MB=y
```

## src/fw/drivers/display/Kconfig
```kconfig
# SPDX-FileCopyrightText: 2026 Core Devices LLC
# SPDX-License-Identifier: Apache-2.0

menuconfig DISPLAY
    bool "Display"
    help
      Display Drivers

if DISPLAY

config DISPLAY_JDI_SF32LB
    bool "JDI (SiFli SF32LB)"
    select HAL_SIFLI_LCD
    help
      Support for JDI display via SiFli SF32LB.

config DISPLAY_SHARP_LS013B7DH01_NRF5
    bool "Sharp LS013B7DH01 (nRF5)"
    help
      Support for the Sharp LS013B7DH01 display via nRF5.

config DISPLAY_SHARP_LS013B7DH01_RP2350
    bool "Sharp LS013B7DH01 (RP2350)"
    help
      Support for the Sharp LS013B7DH01 display via RP2350.

config DISPLAY_SHARP_LS013B7DH01_RP2350_HARDWARE_SPI
    bool "Use RP2350 hardware SPI transport for Sharp display"
    depends on DISPLAY_SHARP_LS013B7DH01_RP2350
    default y
    help
      Use the board-selected RP2350 SPI peripheral for normal Sharp Memory LCD
      updates. Disable this only when falling back to the slower GPIO transport
      for display bring-up diagnostics.

config DISPLAY_SHARP_LS013B7DH01_RP2350_SPI_DIAGNOSTIC_PATTERN
    bool "Show RP2350 Sharp display SPI diagnostic pattern"
    depends on DISPLAY_SHARP_LS013B7DH01_RP2350_HARDWARE_SPI
    help
      Show a visible vertical/X-pattern after display initialization so the
      hardware SPI transport can be identified during bring-up.

config DISPLAY_SHARP_LS013B7DH01_RP2350_BRINGUP_LOOP
    bool "Hold RP2350 Sharp display in bring-up test loop"
    depends on DISPLAY_SHARP_LS013B7DH01_RP2350
    help
      Keep the Fruit Jam RP2350 firmware in a visible FreeRTOS display test
      loop after display initialization.

config DISPLAY_QEMU
    bool "QEMU Framebuffer Display"
    help
      Support for the QEMU framebuffer display peripheral.

module = DRIVER_DISPLAY
module-str = Display
source "src/fw/Kconfig.template.log_level"

endif # DISPLAY
```

## src/fw/drivers/flash/Kconfig
```kconfig
# SPDX-FileCopyrightText: 2026 Core Devices LLC
# SPDX-License-Identifier: Apache-2.0

menuconfig FLASH
    bool "Flash"
    help
      Flash Drivers

if FLASH

config FLASH_GD25LQ255E
    bool "GigaDevice GD25LQ255E"
    help
      Support for the GigaDevice GD25LQ255E NOR flash.

config FLASH_GD25Q256E
    bool "GigaDevice GD25Q256E"
    help
      Support for the GigaDevice GD25Q256E NOR flash.

config FLASH_QEMU
    bool "QEMU External Flash"
    help
      Support for the QEMU external flash peripheral.

config FLASH_RP2350_XIP
    bool "RP2350 XIP Flash"
    help
      Support for RP2350 memory-mapped flash.

module = DRIVER_FLASH
module-str = Flash
source "src/fw/Kconfig.template.log_level"

endif # FLASH
```

## src/fw/drivers/rtc/Kconfig
```kconfig
# SPDX-FileCopyrightText: 2026 Core Devices LLC
# SPDX-License-Identifier: Apache-2.0

menuconfig RTC
    bool "RTC"
    help
      RTC Drivers

if RTC

config RTC_NRF5
    bool "Nordic nRF5"
    help
      Support for the Nordic nRF5 RTC.

config RTC_SF32LB
    bool "SiFli SF32LB"
    select HAL_SIFLI_LRC_CAL
    select HAL_SIFLI_RTC
    help
      Support for the SiFli SF32LB RTC.

config RTC_RP2350
    bool "Raspberry Pi RP2350 RTC"
    help
      Support for the RP2350 timer-backed RTC.

choice RP2350_EXTERNAL_RTC_TYPE
    prompt "RP2350 external RTC type"
    depends on RTC_RP2350
    default RP2350_EXTERNAL_RTC_NONE
    help
      Optional battery-backed RTC connected to RP2350 GPIO pins. Board
      profiles should select a concrete type and pin mapping when fitted.

config RP2350_EXTERNAL_RTC_NONE
    bool "None"

config RP2350_EXTERNAL_RTC_DS1307
    bool "DS1307-compatible"
    help
      Probe and use a DS1307/DS3231-compatible RTC at the configured I2C
      address.

endchoice

config RP2350_EXTERNAL_RTC_I2C_ADDRESS
    int "RP2350 external RTC I2C address"
    depends on RTC_RP2350 && !RP2350_EXTERNAL_RTC_NONE
    range 8 119
    default 104 if RP2350_EXTERNAL_RTC_DS1307

config RP2350_EXTERNAL_RTC_SDA_GPIO
    int "RP2350 external RTC SDA GPIO"
    depends on RTC_RP2350 && !RP2350_EXTERNAL_RTC_NONE
    range 0 47
    default 20 if BOARD_FRUITJAM_RP2350
    default 4 if BOARD_PICO2_W_RP2350

config RP2350_EXTERNAL_RTC_SCL_GPIO
    int "RP2350 external RTC SCL GPIO"
    depends on RTC_RP2350 && !RP2350_EXTERNAL_RTC_NONE
    range 0 47
    default 21 if BOARD_FRUITJAM_RP2350
    default 5 if BOARD_PICO2_W_RP2350

config RTC_QEMU
    bool "QEMU RTC"
    help
      Support for the QEMU RTC peripheral.

module = DRIVER_RTC
module-str = RTC
source "src/fw/Kconfig.template.log_level"

endif # RTC
```

## src/fw/soc/Kconfig
```kconfig
# SPDX-FileCopyrightText: 2026 Core Devices LLC
# SPDX-License-Identifier: Apache-2.0

choice
    prompt "SoC"
    help
      SoC family. Real boards pick a vendor SoC; QEMU boards pick
      SOC_QEMU and then choose a Cortex core explicitly.

config SOC_NRF52
    bool "Nordic nRF52"

config SOC_SF32LB52
    bool "SiFli SF32LB52"

config SOC_RP2350
    bool "Raspberry Pi RP2350"

config SOC_QEMU
    bool "QEMU emulated"

endchoice

config SOC
    string
    default "NRF52" if SOC_NRF52
    default "SF32LB52" if SOC_SF32LB52
    default "RP2350" if SOC_RP2350
    help
      Stringified SoC name, for places that need the name as a token
      (e.g. sftool -c). Empty on QEMU boards.

config QEMU
    bool
    default y if SOC_QEMU
    help
      Derived alias for SOC_QEMU. Gates features that don't make
      sense under emulation.

config RP2350_USB_DEBUG_ONLY
    bool "RP2350 USB debug task only"
    depends on SOC_RP2350
    help
      Bring up only the RP2350 USB debug task and the scheduler. This is a
      board bring-up diagnostic for isolating failures before KernelMain.

config RP2350_USB_POLLED_MAIN
    bool "RP2350 polled USB debug from main"
    depends on SOC_RP2350
    help
      Bring up TinyUSB directly from main without starting FreeRTOS. This is a
      board bring-up diagnostic for separating low-level USB from scheduler and
      runtime issues.

config RP2350_BOOTSEL_ON_MAIN
    bool "RP2350 enter BOOTSEL from main"
    depends on SOC_RP2350
    help
      Immediately re-enter the RP2350 USB bootloader once main starts. This is
      a board bring-up diagnostic for separating startup from scheduler issues.

config RP2350_BOOTSEL_FROM_USB_TASK
    bool "RP2350 enter BOOTSEL from USB debug task"
    depends on SOC_RP2350
    help
      Re-enter the RP2350 USB bootloader once the USB debug task starts. This is
      a board bring-up diagnostic for separating scheduler issues from USB init.

config RP2350_BOOTSEL_AFTER_USB_CLOCK
    bool "RP2350 enter BOOTSEL after USB clock init"
    depends on SOC_RP2350
    help
      Re-enter the RP2350 USB bootloader once the USB debug task completes USB
      clock setup. This localizes USB bring-up failures to clock setup or TinyUSB.

config RP2350_BOOTSEL_AFTER_TUSB_INIT
    bool "RP2350 enter BOOTSEL after TinyUSB init"
    depends on SOC_RP2350
    help
      Re-enter the RP2350 USB bootloader after TinyUSB initialization completes.
      This localizes USB bring-up failures to init or runtime servicing.

config RP2350_BOOTSEL_AFTER_TUD_TASK
    bool "RP2350 enter BOOTSEL after TinyUSB task"
    depends on SOC_RP2350
    help
      Re-enter the RP2350 USB bootloader after one TinyUSB task poll. This
      localizes USB bring-up failures to TinyUSB polling or later runtime code.

config RP2350_BOOTSEL_AFTER_USB_LOOP
    bool "RP2350 enter BOOTSEL after USB loop"
    depends on SOC_RP2350
    help
      Re-enter the RP2350 USB bootloader after a short TinyUSB service loop.
      This checks whether repeated TinyUSB polling and scheduler delays survive.

config RP2350_BOOTSEL_AFTER_USB_REALTIME
    bool "RP2350 enter BOOTSEL after timed USB service window"
    depends on SOC_RP2350
    help
      Re-enter the RP2350 USB bootloader after servicing TinyUSB for a real-time
      window. This gives the host time to enumerate while keeping the diagnostic
      image recoverable without a physical BOOTSEL press.

choice RP2350_PEBBLE_STORAGE_LOCATION
    prompt "RP2350 Pebble storage location"
    depends on SOC_RP2350 && FLASH
    default RP2350_PEBBLE_STORAGE_ONBOARD_XIP
    help
      Select where mutable Pebble storage lives. Firmware still boots from the
      RP2350 boot flash; this controls the resource banks and Pebble filesystem.

config RP2350_PEBBLE_STORAGE_ONBOARD_XIP
    bool "Onboard XIP flash"
    help
      Store system resources and the Pebble filesystem on the same flash chip
      used for RP2350 execute-in-place firmware. This is useful for early
      bring-up, but flash erase/program operations can stall the system.

config RP2350_PEBBLE_STORAGE_EXTERNAL_NOR
    bool "External NOR flash"
    help
      Store system resources and the Pebble filesystem on a separate 3.3 V NOR
      flash device. This is the intended production direction for reliable app
      installs and resource/filesystem updates.

endchoice

config RP2350_PEBBLE_STORAGE_XIP_ERASE_HAZARD
    bool
    depends on SOC_RP2350
    default y if RP2350_PEBBLE_STORAGE_ONBOARD_XIP

choice
    prompt "ARM Cortex core"
    default CORTEX_M4 if SOC_NRF52
    default CORTEX_M33 if SOC_SF32LB52
    default CORTEX_M33 if SOC_RP2350

config CORTEX_M4
    bool "Cortex-M4"

config CORTEX_M33
    bool "Cortex-M33"

endchoice

config MPU_TYPE_ARMV8M
    bool
    default y if CORTEX_M33

config MPU_TYPE_ARMV7M
    bool
    default y if !MPU_TYPE_ARMV8M
```

## src/fw/soc/rp2350/Kconfig.defconfig
```kconfig
# SPDX-FileCopyrightText: 2026 Core Devices LLC
# SPDX-License-Identifier: Apache-2.0

if SOC_RP2350

choice BT_FW
    default BT_FW_NIMBLE
endchoice

endif # SOC_RP2350
```
